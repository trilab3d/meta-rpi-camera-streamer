## conf/layer.conf
```bitbake
# We have a conf and classes directory, add to BBPATH
BBPATH .= ":${LAYERDIR}"

# We have recipes-* directories, add to BBFILES
BBFILES += "${LAYERDIR}/recipes-*/*/*.bb \
            ${LAYERDIR}/recipes-*/*/*.bbappend"

BBFILE_COLLECTIONS += "meta-rpi-camera-streamer"
BBFILE_PATTERN_meta-rpi-camera-streamer = "^${LAYERDIR}/"
BBFILE_PRIORITY_meta-rpi-camera-streamer = "6"

LAYERDEPENDS_meta-rpi-camera-streamer = "core"
LAYERSERIES_COMPAT_meta-rpi-camera-streamer = "kirkstone mickledore"

KERNEL_DEVICETREE:append = " overlays/imx290.dtbo \
                            overlays/imx519.dtbo \
                            overlays/ov5647.dtbo \
                            overlays/ov9281.dtbo"
```
